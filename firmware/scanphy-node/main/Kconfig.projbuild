## firmware/scanphy-node/main/Kconfig.projbuild
```kconfig
menu "scanPHY node"
    config SCANPHY_WIFI_SSID
        string "WiFi SSID (default, overridden by provisioning)"
        default "scanphy"
    config SCANPHY_WIFI_PASSWORD
        string "WiFi password"
        default "scanphy123"
    config SCANPHY_TARGET_IP
        string "Jetson / server IP address"
        default "192.168.1.100"
    config SCANPHY_TARGET_PORT
        int "Server UDP port"
        default 5005
    config SCANPHY_NODE_ID
        int "Node id (1-3)"
        range 1 255
        default 1
    config SCANPHY_RATE_HZ
        int "Target CSI frames per second"
        range 5 200
        default 50
endmenu
```

## firmware/wavesense-node/main/Kconfig.projbuild
```kconfig
menu "WaveSense 3D node"
    config WAVESENSE_WIFI_SSID
        string "WiFi SSID (default, overridden by provisioning)"
        default "wavesense"
    config WAVESENSE_WIFI_PASSWORD
        string "WiFi password"
        default "wavesense123"
    config WAVESENSE_TARGET_IP
        string "Jetson / server IP address"
        default "192.168.1.100"
    config WAVESENSE_TARGET_PORT
        int "Server UDP port"
        default 5005
    config WAVESENSE_NODE_ID
        int "Node id (1-3)"
        range 1 255
        default 1
    config WAVESENSE_RATE_HZ
        int "Target CSI frames per second"
        range 5 200
        default 50
endmenu
```

## firmware/wavesense-node/sdkconfig.defaults
```kconfig
CONFIG_ESPTOOLPY_FLASHSIZE_4MB=y
CONFIG_PARTITION_TABLE_CUSTOM=y
CONFIG_PARTITION_TABLE_CUSTOM_FILENAME="partitions.csv"
CONFIG_ESP_WIFI_CSI_ENABLED=y
CONFIG_ESP_WIFI_AMPDU_TX_ENABLED=n
CONFIG_FREERTOS_HZ=1000
CONFIG_LWIP_SO_REUSE=y
CONFIG_ESP_MAIN_TASK_STACK_SIZE=6144
CONFIG_LOG_DEFAULT_LEVEL_INFO=y
```
